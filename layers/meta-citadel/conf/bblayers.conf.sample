## layers/meta-citadel/conf/bblayers.conf.sample
```bitbake
# POKY_BBLAYERS_CONF_VERSION is increased each time build/conf/bblayers.conf
# changes incompatibly
POKY_BBLAYERS_CONF_VERSION = "2"

BBPATH = "${TOPDIR}"
BBFILES ?= ""

BBLAYERS ?= " \
  ##OEROOT##/meta \
  ##OEROOT##/../layers/meta-intel \
  ##OEROOT##/../layers/meta-rust \
  ##OEROOT##/../layers/meta-openembedded/meta-initramfs \
  ##OEROOT##/../layers/meta-openembedded/meta-oe \
  ##OEROOT##/../layers/meta-openembedded/meta-python \
  ##OEROOT##/../layers/meta-openembedded/meta-networking \
  ##OEROOT##/../layers/meta-openembedded/meta-gnome \
  ##OEROOT##/../layers/meta-citadel \
  "
```
